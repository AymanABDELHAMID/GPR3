## webserver/meta-node-webserver/conf/layer.conf
```bitbake
# We have a conf and classes directory, add to BBPATH
BBPATH .= ":${LAYERDIR}"

# We have recipes-* directories, add to BBFILES
BBFILES += "${LAYERDIR}/recipes-*/*/*.bb \
            ${LAYERDIR}/recipes-*/*/*.bbappend"

BBFILE_COLLECTIONS += "meta-node-webserver"
BBFILE_PATTERN_meta-node-webserver = "^${LAYERDIR}/"
BBFILE_PRIORITY_meta-node-webserver = "6"

LAYERSERIES_COMPAT_meta-node-webserver = "rocko"
```
